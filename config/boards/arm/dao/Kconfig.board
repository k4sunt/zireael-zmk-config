## config/boards/arm/dao/Kconfig.board
```kconfig
# Dao board configuration
#
# Copyright (c) 2021 Rafael Yumagulov
# SPDX-License-Identifier: MIT

source "Kconfig.dao"
```

## config/boards/arm/dao/Kconfig.dao
```kconfig
# Dao board configuration

# Copyright (c) 2021 Rafael Yumagulov
# SPDX-License-Identifier: MIT

config BOARD_DAO_LEFT
	bool "Dao Left"
	select SOC_SERIES_NRF52X
	select SOC_NRF52840_QIAA

config BOARD_DAO_RIGHT
	bool "Dao Right"
	select SOC_SERIES_NRF52X
	select SOC_NRF52840_QIAA

config BOARD_DAO_DONGLE
	bool "Dao Dongle"
	select SOC_SERIES_NRF52X
	select SOC_NRF52840_QIAA
```

## config/boards/arm/dao/Kconfig.defconfig
```kconfig
# Copyright (c) 2021 Rafael Yumagulov
# SPDX-License-Identifier: MIT

if BOARD_DAO_LEFT

	config ZMK_KEYBOARD_NAME
	default "Dao Left"

    # config ZMK_SPLIT_BLE_ROLE_CENTRAL  # Dongle acts as central
	# 	default y

endif # BOARD_DAO_LEFT

if BOARD_DAO_RIGHT

	config ZMK_KEYBOARD_NAME
	default "Dao Right"

endif # BOARD_DAO_RIGHT

if BOARD_DAO_DONGLE

	config ZMK_KEYBOARD_NAME
	default "Dao Dongle"

    config ZMK_SPLIT_BLE_ROLE_CENTRAL
	default y

endif # BOARD_DAO_DONGLE

if BOARD_DAO_LEFT || BOARD_DAO_RIGHT || BOARD_DAO_DONGLE

config BOARD
	default "dao"

config ZMK_SPLIT
	default y

config BT_CTLR

	default BT

if !BOARD_DAO_DONGLE

config ZMK_BATTERY_VOLTAGE_DIVIDER
	default y

endif # !BOARD_DAO_DONGLE

if USB

config USB_NRFX
	default y

config USB_DEVICE_STACK
	default y

endif # USB

endif # BOARD_DAO_LEFT || BOARD_DAO_RIGHT || BOARD_DAO_DONGLE
```

## config/boards/arm/dao_dongle/Kconfig.board
```kconfig
# Dao Dongle board configuration
#
# Copyright (c) 2021 Rafael Yumagulov
# SPDX-License-Identifier: MIT

config BOARD_DAO_DONGLE
	bool "Dao Dongle"
	select SOC_NRF52840_QIAA
```

## config/boards/arm/dao_dongle/Kconfig.defconfig
```kconfig
# Copyright (c) 2021 Rafael Yumagulov
# SPDX-License-Identifier: MIT

if BOARD_DAO_DONGLE

config BOARD
	default "dao_dongle"

config ZMK_KEYBOARD_NAME
	default "Dao Dongle"

config ZMK_SPLIT
	default y

config ZMK_SPLIT_BLE_ROLE_CENTRAL
	default y

config BT_CTLR
	default BT

if USB

config USB_NRFX
	default y

config USB_DEVICE_STACK
	default y

endif # USB

endif # BOARD_DAO_DONGLE
```

## config/boards/arm/dao_dongle/board.yml
```yaml
board:
  name: dao_dongle
  vendor: dao
  socs:
    - name: nrf52840
      variants:
        - name: qiaa
```

## config/boards/arm/dao_left/Kconfig.board
```kconfig
# Dao Left board configuration
#
# Copyright (c) 2021 Rafael Yumagulov
# SPDX-License-Identifier: MIT

config BOARD_DAO_LEFT
	bool "Dao Left"
	select SOC_NRF52840_QIAA
```

## config/boards/arm/dao_right/Kconfig.board
```kconfig
# Dao Right board configuration
#
# Copyright (c) 2021 Rafael Yumagulov
# SPDX-License-Identifier: MIT

config BOARD_DAO_RIGHT
	bool "Dao Right"
	depends on SOC_SERIES_NRF52X
	select SOC_NRF52840_QIAA
```

## config/boards/dao/dao_dongle/dao_dongle_nrf52840_defconfig
```kconfig
# SPDX-License-Identifier: MIT

# --- ZMK core ---
CONFIG_ZMK_SPLIT=y
CONFIG_ZMK_SPLIT_ROLE_CENTRAL=y
CONFIG_ZMK_SLEEP=y

# --- MPU / GPIO ---
CONFIG_ARM_MPU=y
CONFIG_GPIO=y

# --- Flash / settings ---
CONFIG_USE_DT_CODE_PARTITION=y
CONFIG_MPU_ALLOW_FLASH_WRITE=y
CONFIG_NVS=y
CONFIG_SETTINGS_NVS=y
CONFIG_FLASH=y
CONFIG_FLASH_PAGE_LAYOUT=y
CONFIG_FLASH_MAP=y

# --- Build outputs (Nordic Open Bootloader DFU) ---
CONFIG_BUILD_OUTPUT_BIN=y
CONFIG_BUILD_OUTPUT_HEX=n
CONFIG_BUILD_OUTPUT_UF2=n

# --- Bluetooth ---
CONFIG_ZMK_BLE=y
CONFIG_BT_CTLR_TX_PWR_PLUS_8=y

# --- USB (ZMK-controlled) ---
CONFIG_ZMK_USB=y
CONFIG_USB_DEVICE_STACK=y
CONFIG_USB_DEVICE_HID=y

# Required clock source for nRF52840 USB
CONFIG_CLOCK_CONTROL_NRF_K32SRC_XTAL=y

# USB identity
CONFIG_USB_DEVICE_VID=0x1915
CONFIG_USB_DEVICE_PID=0x521F
CONFIG_USB_DEVICE_MANUFACTURER="Raytac"
CONFIG_USB_DEVICE_PRODUCT="DAO ZMK Dongle"
```

## config/boards/dao/dao_left/Kconfig.dao_left
```kconfig
# Copyright (c) 2021 Rafael Yumagulov
# SPDX-License-Identifier: MIT

config BOARD_DAO_LEFT
	bool "Dao Left"
	select SOC_SERIES_NRF52X
	select SOC_NRF52840_QIAA
```

## config/boards/dao/dao_left/Kconfig.defconfig
```kconfig
# Copyright (c) 2021 Rafael Yumagulov
# SPDX-License-Identifier: MIT

if BOARD_DAO_LEFT

config BOARD
	default "dao_left"

config SOC
	default "nrf52840_qiaa"

config ARM
	default y

config ZMK_KEYBOARD_NAME
	default "Dao"

config ZMK_SPLIT_BLE_ROLE_CENTRAL
	default y

config ZMK_SPLIT
	default y

config BT_CTLR
	default BT

config ZMK_BATTERY_VOLTAGE_DIVIDER
	default y

config BUILD_OUTPUT_UF2
	default y

endif # BOARD_DAO_LEFT
```

## config/boards/dao/dao_right/Kconfig.dao_right
```kconfig
# Copyright (c) 2021 Rafael Yumagulov
# SPDX-License-Identifier: MIT

config BOARD_DAO_RIGHT
	bool "Dao Right"
	depends on SOC_NRF52840_QIAA
```

## config/boards/dao/dao_right/Kconfig.defconfig
```kconfig
# Copyright (c) 2021 Rafael Yumagulov
# SPDX-License-Identifier: MIT

if BOARD_DAO_RIGHT

config SOC
	default "nrf52840_qiaa"

config ARM
	default y

config CPU_CORTEX_M4
	default y

config BOARD
	default "dao_right"

config ZMK_KEYBOARD_NAME
	default "Dao Right"

config ZMK_SPLIT
	default y

config BT_CTLR
	default BT

config ZMK_BATTERY_VOLTAGE_DIVIDER
	default y

config BUILD_OUTPUT_UF2
	default y

endif # BOARD_DAO_RIGHT
```

## config/boards/dao/dao_right/board.yml
```yaml
board:
  name: dao_right
  vendor: dao
  socs:
    - name: nrf52840
      variants:
        - name: qiaa
```
